## manifest/west.yml
```yaml
# `west` manifest file, used to declare Zephyr modules we depend on.
# See details at
# https://docs.zephyrproject.org/latest/develop/west/manifest.html
manifest:
  remotes:
    - name: zephyrproject-rtos
      url-base: https://github.com/zephyrproject-rtos
    - name: pigweed-git
      url-base: https://pigweed.googlesource.com/pigweed

  projects:
    - name: zephyr
      remote: zephyrproject-rtos
      revision: main
      clone-depth: 50
      import: true
    - name: pigweed
      remote: pigweed-git
      revision: main
      clone-depth: 50
```
